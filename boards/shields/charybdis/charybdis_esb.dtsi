/ {
    esb_split {
        compatible = "zmk,esb-split";
        base-addr-0 = <0xe7 0xe7 0xe7 0xe7>;
        base-addr-1 = <0xc2 0xc2 0xc2 0xc2>;
        addr-prefix = <0xe7 0xc2 0xc3 0xc4 0xc5 0xc6 0xc7 0xc8>;
    };
};
