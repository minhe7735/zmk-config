/ {
    esb_split {
        compatible = "zmk,esb-split";
        base-addr-0 = <0xd1 0xd1 0xd1 0xd1>;
        base-addr-1 = <0xb3 0xb3 0xb3 0xb3>;
        addr-prefix = <0xd1 0xb3 0xb4 0xb5 0xb6 0xb7 0xb8 0xb9>;
    };
};
