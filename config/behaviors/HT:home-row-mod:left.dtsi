#ifndef HT_HOME_ROW_MOD_LEFT_DTSI
#define HT_HOME_ROW_MOD_LEFT_DTSI

#include <behaviors.dtsi>
#include <dt-bindings/zmk/keys.h>

// Key position groups for home row mods
#define KEYS_R 5 6 7 8 9 15 16 17 18 19 25 26 27 28 29

#ifdef IS_CHARYBDIS
    #define THUMBS 30 31 32 33 34 35
#else
    #define THUMBS 30 31 32 33 34 35 36
#endif

/ {
    behaviors {
        hml: homerow_mods_left {
            compatible = "zmk,behavior-hold-tap";
            label = "HOMEROW_MODS_LEFT";
            bindings = <&kp>, <&kp>;
            #binding-cells = <2>;
            flavor = "balanced";
            tapping-term-ms = <5000>;
            require-prior-idle-ms = <250>;
            quick-tap-ms = <150>;
            hold-trigger-on-release;
            hold-trigger-key-positions = <KEYS_R THUMBS>;
        };
    };
};

#endif
