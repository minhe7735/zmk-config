// Home row mods with mouse movement macros
hmr_cml: homerow_ctrl_pointer_left {
  compatible = "zmk,behavior-hold-tap";
  label = "HOMEROW_CTRL_POINTER_LEFT";
  bindings = <&cml>, <&kp>;
  #binding-cells = <2>;
  flavor = "balanced";
  tapping-term-ms = <280>;
  require-prior-idle-ms = <250>;
  quick-tap-ms = <150>;
  hold-trigger-on-release;
  hold-trigger-key-positions = <KEYS_L THUMBS>;
};
