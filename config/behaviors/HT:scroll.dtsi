// Mouse wheel with tap-hold
mt_wheel: wheel_tap_hold {
  compatible = "zmk,behavior-hold-tap";
  label = "WHEEL_TAP_HOLD";
  flavor = "tap-preferred";
  bindings = <&msc>, <&kp>;
  #binding-cells = <2>;
  tapping-term-ms = <200>;
  quick-tap-ms = <150>;
};
