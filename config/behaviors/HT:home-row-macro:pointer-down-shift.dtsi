hmr_smd: homerow_shift_POINTER_down {
  compatible = "zmk,behavior-hold-tap";
  label = "HOMEROW_SHIFT_POINTER_DOWN";
  bindings = <&smd>, <&kp>;
  #binding-cells = <2>;
  flavor = "balanced";
  tapping-term-ms = <280>;
  require-prior-idle-ms = <250>;
  quick-tap-ms = <150>;
  hold-trigger-on-release;
  hold-trigger-key-positions = <KEYS_L THUMBS>;
};
