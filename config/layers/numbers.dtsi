// Number layer (3) - Numbers and navigation
Number {
  display-name = "Number";
  bindings = <
    &none    &kp N7         &kp N8          &kp N9          &none                &none         &kp PG_UP         &kp UP            &kp PG_DN         &none
    &kp LGUI &hml_s LALT N4 &hml_s LSHFT N5 &hml_s LCTRL N6 &none                &none         &hmr_s RCTRL LEFT &hmr_s RSHFT DOWN &hmr_s RALT RIGHT &kp RGUI
    &none    &kp N1         &kp N2          &kp N3          &kp LC(MINUS)        &kp LC(EQUAL) &kp HOME          &trans            &kp END           &none
                            &kp DOT         &kp N0          &kp SPACE            &trans            &none

                                                                      #ifndef IS_CHARYBDIS
                                                                           &none
                                                                      #endif
>;
};
