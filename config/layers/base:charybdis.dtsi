Base {
  display-name = "Base";
  bindings = <
    &kp FSLH    &kp W       &kp F           &kp P        &kp B                   &kp J                &kp L                      &kp U        &kp Y       &kp SEMI
    &hml LGUI A &hml LALT R &hml LSHFT S    &hml LCTRL T &kp G                   &kp M                &hmr RCTRL N               &hmr RSHFT E &hmr RALT I &hmr LGUI O
    &kp Z       &mt LC(X) X &mt LC(C) C     &kp D        &mt LC(V) V             &kp K                &kp H                      &kp COMMA    &kp DOT     &kp Q
                            &mt LGUI ESCAPE &smart_shift &lt SYMBOL SPACE        &lt NUMBER BACKSPACE &mt LS(LC(LEFT_ALT)) ENTER

                                                                      #ifndef IS_CHARYBDIS
                                                                           &none
                                                                      #endif
  >;
};
