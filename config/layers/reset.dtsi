Reset {
  display-name = "Reset";
  bindings = <
    &none &none &none &none &none              &none &none &none &none &none     
    &none &none &none &none &none              &none &none &none &none &none    
    &none &none &none &none &none              &none &none &none &none &none
                &none &none &bootloader        &bootloader &none               

                                    #ifndef IS_CHARYBDIS
                                         &none
                                    #endif
  >;
};
