## config/west.yml
```yaml
manifest:
  remotes:
    - name: zmkfirmware
      url-base: https://github.com/zmkfirmware
    - name: badjeff
      url-base: https://github.com/badjeff
    - name: efogdev
      url-base: https://github.com/efogdev
    - name: minhe7735 
      url-base: https://github.com/minhe7735
    - name: carrefinho
      url-base: https://github.com/carrefinho
  projects:
    - name: zmk
      remote: zmkfirmware
      revision: main
      import: app/west.yml
    - name: zmk-pmw3610-driver
      remote: efogdev
      revision: zephyr-4.1
    - name: zmk-input-processor-xyz
      remote: badjeff
      revision: main
    - name: zmk-behavior-battery-percentage-printer
      remote: badjeff
      revision: main
    - name: zmk-report-rate-limit
      remote: minhe7735
      revision: main
    - name: prospector-zmk-module
      remote: carrefinho 
      revision: feat/new-status-screens
    - name: text-expander
      remote: minhe7735
      revision: dev
  self:
    path: config
```
