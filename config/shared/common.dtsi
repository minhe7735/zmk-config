#include <behaviors.dtsi>
#include <dt-bindings/zmk/keys.h>
#include <dt-bindings/zmk/bt.h>
#include <dt-bindings/zmk/mouse.h>
#include <dt-bindings/zmk/outputs.h>
#include <dt-bindings/zmk/input_transform.h>
#include <zephyr/dt-bindings/input/input-event-codes.h>
#include <input/processors.dtsi>

// Shared key position definitions
#define KEYS_L 0 1 2 3 4 10 11 12 13 14 20 21 22 23 24  
#define KEYS_R 5 6 7 8 9 15 16 17 18 19 25 26 27 28 29
#define THUMBS 30 31 32 33 34 35

#include "behaviors.dtsi"
#include "combos.dtsi"
#include "processors.dtsi"
#include "macros.dtsi"
