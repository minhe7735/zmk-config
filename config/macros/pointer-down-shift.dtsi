// Shift + Mouse Down movement
smd: shift_mouse_down {
    compatible = "zmk,behavior-macro";
    label = "SHIFT_MOUSE_DOWN";
    #binding-cells = <0>;
    wait-ms = <0>;
    tap-ms = <0>;
    bindings =
        <&macro_press &mmv MOVE_DOWN &kp RSHFT>,
        <&macro_pause_for_release>,
        <&macro_release &mmv MOVE_DOWN &kp RSHFT>;
};
