// Alt + Mouse Right movement
amr: alt_mouse_right {
    compatible = "zmk,behavior-macro";
    label = "ALT_MOUSE_RIGHT";
    #binding-cells = <0>;
    wait-ms = <0>;
    tap-ms = <0>;
    bindings =
        <&macro_press &mmv MOVE_RIGHT &kp RALT>,
        <&macro_pause_for_release>,
        <&macro_release &mmv MOVE_RIGHT &kp RALT>;
};
