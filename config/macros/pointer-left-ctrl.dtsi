// Ctrl + Mouse Left movement
cml: ctrl_mouse_left {
    compatible = "zmk,behavior-macro";
    label = "CTRL_MOUSE_LEFT";
    #binding-cells = <0>;
    wait-ms = <0>;
    tap-ms = <0>;
    bindings =
        <&macro_press &mmv MOVE_LEFT &kp RCTRL>,
        <&macro_pause_for_release>,
        <&macro_release &mmv MOVE_LEFT &kp RCTRL>;
};

